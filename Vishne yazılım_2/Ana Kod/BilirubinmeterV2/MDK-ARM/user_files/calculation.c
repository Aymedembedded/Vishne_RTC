#include "calculation.h"
#include <string.h>

float Deneme[266]={5672,5702,5654,5670,5694,5674,5663,5684,5662,5676,5648,5668,5670,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5655
};
float movAvData[256];
float Reflectance[256];
float RefSpect[256]={-0.010105323,-0.001542245,-0.013827409,-0.016224875,-0.015162678,-0.016783329,-0.019090998,-0.020490656,-0.025685276,-0.02442543,-0.022746399,-0.022733002,-0.025591919,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0.002343606
};
float Ref[256];
float VID_53_56;
float VID_95_01;
float VIDR_53_56;
float VIDR_95_01;
float Bil;
float BilResult[1];
/*uint16_t res[2];
char asciiresult[10];
char asciiresult2[10];*/
uint16_t 	max;
	
/******************************** Absolute Process******************/
long absolute(long value) 
{
	if (value < 0) {
	return -value;
	}
	else {
	return value;  
	}
}
			
/******************************** Moving Avarage Process******************/		
void movingAvarage(void)
{
	for ( int idx=0;idx<256; idx++)
	{
		if ( idx < 0  ||  idx>255)
		{
			movAvData[idx] = Reflectance[idx];
		}
		else 
		{
			movAvData[idx] =
			( 
			Reflectance[idx-1]+
			Reflectance[idx]+
			Reflectance[idx+1]) / 3;
		}
	}
}	
	
	
/******************************** Max Value Process******************/
uint16_t find_maximum(uint16_t a[], uint16_t n) 
{
	uint16_t  	c, index;
	max = a[0];
	index = 0;
	for (c = 1; c < n; c++) 
	{
		if (a[c] > max) 
		{
			index = c;
			max = a[c];
		}
	}
	return max;
}

/******************************** Bilirubin Formula******************/
void BilCalculation(void)
{
	
	uint16_t calVideoData[256];
	uint16_t calWhtVideoData[256];
	uint16_t calDrkVideoData[256];
	
	W25qxx_ReadSector((uint8_t *)calWhtVideoData,1622,0,512);
	W25qxx_ReadSector((uint8_t *)calDrkVideoData,1621,0,512);/*
	if(calWhtVideoData != NULL && calDrkVideoData != NULL)
	{
		for(int i = 0; i < 256; i++)
		{
			calVideoData[i] = calWhtVideoData[i] - calDrkVideoData[i];
		}
		VID_53_56=(calVideoData[252]+calVideoData[253]+calVideoData[254]+calVideoData[255])/4;
  }
  else
	{
		VID_53_56=(VIDEO_DATA[252]+VIDEO_DATA[253]+VIDEO_DATA[254]+VIDEO_DATA[255])/4;
	}
	*/
	
	VID_53_56=(VIDEO_DATA[252]+VIDEO_DATA[253]+VIDEO_DATA[254]+VIDEO_DATA[255])/4;
	VID_53_56 = VID_53_56 - (calDrkVideoData[252]+calDrkVideoData[253]+calDrkVideoData[254]+calDrkVideoData[255])/4;
	for(int r=0; r<256; r++)
	{
	Reflectance[r]=VIDEO_DATA[r]-VID_53_56;
	}
		VID_95_01=(Reflectance[94]+Reflectance[95]+Reflectance[96]+Reflectance[97]+Reflectance[98]+Reflectance[99]+Reflectance[100])/7;
		for(int r=0; r<256; r++)
	{
	Reflectance[r]=Reflectance[r]/VID_95_01;
	}
		for(int r=0; r<256; r++)
	{
	Reflectance[r]=Reflectance[r]/RefSpect[r];
	}
	movingAvarage();
	Bil=movAvData[64]+movAvData[65]+movAvData[66]+movAvData[67]+movAvData[68]+movAvData[69]+movAvData[70]+movAvData[71]+movAvData[72];
	//Bil = Bil / 9.0f;
	BilResult[0]=(1.7016*Bil*Bil)-(20.6755*Bil)+(66.9023);
	//BilResult[0]=(0.4132*Bil*Bil)-(3.7411*Bil)+(10.5542);
	//result=result/6;
	
	/*sprintf(str1, "%.1lf", BilResult[0]);
	ILI9341_WriteString(5, 100, str1, Font_16x26, ILI9341_RED, ILI9341_YELLOW);*/
	
	/*res[0]=BilResult[0];
	BilResult[0]=BilResult[0]*1000;
	res[1]=BilResult[0]-(res[0]*1000);
	my_itoa(asciiresult,res[0]);
	my_itoa(asciiresult2,res[1]);*/
	
/*	sprintf(str2, "%d", res[0]);
	ILI9341_WriteString(5, 150, str2, Font_16x26, ILI9341_RED, ILI9341_YELLOW);
	sprintf(str3, "%d", res[1]);
	ILI9341_WriteString(5, 200, str3, Font_16x26, ILI9341_RED, ILI9341_YELLOW);
	//HAL_Delay(1000);*/

}



